## conf/layer.conf
```bitbake
BBFILES += "${LAYERDIR}/recipes/*/*.bb ${LAYERDIR}/recipes/*/*.bbappend ${LAYERDIR}/recipes-*/*/*.bb ${LAYERDIR}/recipes-*/*/*.bbappend"
BBPATH .= ":${LAYERDIR}"
BBFILE_COLLECTIONS += "pal"
BBFILE_PRIORITY_pal = "12"
BBFILE_PATTERN_pal := "^${LAYERDIR}/"
LAYERSERIES_COMPAT_pal = "dunfell kirkstone"
```
